## drivers/soc/qcom/Kconfig
```kconfig
# SPDX-License-Identifier: GPL-2.0-only
#
# QCOM Soc drivers
#
menu "Qualcomm SoC drivers"

config QCOM_AOSS_QMP
	tristate "Qualcomm AOSS Driver"
	depends on ARCH_QCOM || COMPILE_TEST
	depends on MAILBOX
	depends on COMMON_CLK && PM
	select PM_GENERIC_DOMAINS
	help
	  This driver provides the means of communicating with and controlling
	  the low-power state for resources related to the remoteproc
	  subsystems as well as controlling the debug clocks exposed by the Always On
	  Subsystem (AOSS) using Qualcomm Messaging Protocol (QMP).

config QCOM_COMMAND_DB
	tristate "Qualcomm Command DB"
	depends on ARCH_QCOM || COMPILE_TEST
	depends on OF_RESERVED_MEM
	help
	  Command DB queries shared memory by key string for shared system
	  resources. Platform drivers that require to set state of a shared
	  resource on a RPM-hardened platform must use this database to get
	  SoC specific identifier and information for the shared resources.

config QCOM_CRM
	tristate "Qualcomm Technologies, Inc. (QTI) CRM driver"
	depends on QCOM_RPMH && (ARCH_QCOM || COMPILE_TEST)
	help
	  Support for communication with the hardened-CRM blocks in
	  Qualcomm Technologies, Inc. (QTI) SoCs. CRM provides interface to
	  vote desired power state of resources local to a subsystem. A set
	  of hardware components aggregate requests for these resources and
	  help apply the aggregated power state on the resource.

config QCOM_CPR
	tristate "QCOM Core Power Reduction (CPR) support"
	depends on ARCH_QCOM && HAS_IOMEM
	select PM_OPP
	select REGMAP
	help
	  Say Y here to enable support for the CPR hardware found on Qualcomm
	  SoCs like QCS404.

	  This driver populates CPU OPPs tables and makes adjustments to the
	  tables based on feedback from the CPR hardware. If you want to do
	  CPUfrequency scaling say Y here.

	  To compile this driver as a module, choose M here: the module will
	  be called qcom-cpr

config QCOM_GENI_SE
	tristate "QCOM GENI Serial Engine Driver"
	depends on ARCH_QCOM || COMPILE_TEST
	help
	  This driver is used to manage Generic Interface (GENI) firmware based
	  Qualcomm Technologies, Inc. Universal Peripheral (QUP) Wrapper. This
	  driver is also used to manage the common aspects of multiple Serial
	  Engines present in the QUP.

config QCOM_GSBI
	tristate "QCOM General Serial Bus Interface"
	depends on ARCH_QCOM || COMPILE_TEST
	select MFD_SYSCON
	help
	  Say y here to enable GSBI support.  The GSBI provides control
	  functions for connecting the underlying serial UART, SPI, and I2C
	  devices to the output pins.

config QCOM_LLCC
	tristate "Qualcomm Technologies, Inc. LLCC driver"
	depends on ARCH_QCOM || COMPILE_TEST
	select REGMAP_MMIO
	help
	  Qualcomm Technologies, Inc. platform specific
	  Last Level Cache Controller(LLCC) driver for platforms such as,
	  SDM845. This provides interfaces to clients that use the LLCC.
	  Say yes here to enable LLCC slice driver.

config QCOM_KRYO_L2_ACCESSORS
	bool
	depends on ARCH_QCOM && ARM64 || COMPILE_TEST

config QCOM_MDT_LOADER
	tristate
	select QCOM_SCM

config QCOM_OCMEM
	tristate "Qualcomm On Chip Memory (OCMEM) driver"
	depends on ARCH_QCOM
	select QCOM_SCM
	help
	  The On Chip Memory (OCMEM) allocator allows various clients to
	  allocate memory from OCMEM based on performance, latency and power
	  requirements. This is typically used by the GPU, camera/video, and
	  audio components on some Snapdragon SoCs.

config QCOM_PDR_HELPERS
	tristate
	select QCOM_QMI_HELPERS

config QCOM_PANIC_ON_PDR_NOTIF_TIMEOUT
	bool "Trigger kernel panic when PDR notification timeout expires"
	help
	  This is a debug feature where a kernel panic is triggered when
	  pdr notification to the APPS client is taking too long. This scneario
	  can happen if the one of notifier gets stuck and due to which subsystem
	  did not get ack back from APPS in time and trigger timeout panic.
	  So, trigger a kernel panic in APPS if PDR notifications is taking
	  too long.

config PDR_INDICATION_NOTIF_TIMEOUT
	int "Pdr notifications timeout in ms"
	default 3000
	help
	  The amount of time, in milliseconds, that should elapse between
	  the start and end of notifications, before a warning
	  is emitted.

config QCOM_QMI_HELPERS
	tristate
	depends on NET

config QCOM_RMTFS_MEM
	tristate "Qualcomm Remote Filesystem memory driver"
	depends on ARCH_QCOM
	select QCOM_SCM
	help
	  The Qualcomm remote filesystem memory driver is used for allocating
	  and exposing regions of shared memory with remote processors for the
	  purpose of exchanging sector-data between the remote filesystem
	  service and its clients.

	  Say y here if you intend to boot the modem remoteproc.

config QCOM_RPMH
	tristate "Qualcomm RPM-Hardened (RPMH) Communication"
	depends on ARCH_QCOM || COMPILE_TEST
	depends on (QCOM_COMMAND_DB || !QCOM_COMMAND_DB)
	help
	  Support for communication with the hardened-RPM blocks in
	  Qualcomm Technologies Inc (QTI) SoCs. RPMH communication uses an
	  internal bus to transmit state requests for shared resources. A set
	  of hardware components aggregate requests for these resources and
	  help apply the aggregated state on the resource.

config QCOM_RPMHPD
	tristate "Qualcomm RPMh Power domain driver"
	depends on QCOM_RPMH && QCOM_COMMAND_DB
	help
	  QCOM RPMh Power domain driver to support power-domains with
	  performance states. The driver communicates a performance state
	  value to RPMh which then translates it into corresponding voltage
	  for the voltage rail.

config QCOM_RPMPD
	tristate "Qualcomm RPM Power domain driver"
	depends on PM && OF
	depends on QCOM_SMD_RPM
	select PM_GENERIC_DOMAINS
	select PM_GENERIC_DOMAINS_OF
	help
	  QCOM RPM Power domain driver to support power-domains with
	  performance states. The driver communicates a performance state
	  value to RPM which then translates it into corresponding voltage
	  for the voltage rail.

config QCOM_SMEM
	tristate "Qualcomm Shared Memory Manager (SMEM)"
	depends on ARCH_QCOM || COMPILE_TEST
	depends on HWSPINLOCK
	help
	  Say y here to enable support for the Qualcomm Shared Memory Manager.
	  The driver provides an interface to items in a heap shared among all
	  processors in a Qualcomm platform.

config QCOM_SMD_RPM
	tristate "Qualcomm Resource Power Manager (RPM) over SMD"
	depends on ARCH_QCOM || COMPILE_TEST
	depends on RPMSG
	help
	  If you say yes to this option, support will be included for the
	  Resource Power Manager system found in the Qualcomm 8974 based
	  devices.

	  This is required to access many regulators, clocks and bus
	  frequencies controlled by the RPM on these devices.

	  Say M here if you want to include support for the Qualcomm RPM as a
	  module. This will build a module called "qcom-smd-rpm".

config QCOM_SMEM_STATE
	bool

config QCOM_SMP2P
	tristate "Qualcomm Shared Memory Point to Point support"
	depends on MAILBOX
	depends on QCOM_SMEM
	select QCOM_SMEM_STATE
	select IRQ_DOMAIN
	help
	  Say yes here to support the Qualcomm Shared Memory Point to Point
	  protocol.

config QCOM_SMSM
	tristate "Qualcomm Shared Memory State Machine"
	depends on QCOM_SMEM
	select QCOM_SMEM_STATE
	select IRQ_DOMAIN
	help
	  Say yes here to support the Qualcomm Shared Memory State Machine.
	  The state machine is represented by bits in shared memory.

config QCOM_SOCINFO
	tristate "Qualcomm socinfo driver"
	depends on QCOM_SMEM
	select SOC_BUS
	help
	 Say yes here to support the Qualcomm socinfo driver, providing
	 information about the SoC to user space.

config QCOM_SPM
	tristate "Qualcomm Subsystem Power Manager (SPM)"
	depends on ARCH_QCOM || COMPILE_TEST
	select QCOM_SCM
	help
	  Enable the support for the Qualcomm Subsystem Power Manager, used
	  to manage cores, L2 low power modes and to configure the internal
	  Adaptive Voltage Scaler parameters, where supported.

config QCOM_STATS
	tristate "Qualcomm Technologies, Inc. (QTI) Sleep stats driver"
	depends on (ARCH_QCOM && DEBUG_FS) || COMPILE_TEST
	depends on QCOM_SMEM
	help
	  Qualcomm Technologies, Inc. (QTI) Sleep stats driver to read
	  the shared memory exported by the remote processor related to
	  various SoC level low power modes statistics and export to debugfs
	  interface.

config QCOM_WDT_CORE
	tristate "Qualcomm Technologies, Inc. Watchdog Support"
	depends on ARCH_QCOM
	help
	   This enables the watchdog framework for Qualcomm Technologies, Inc.
	   devices. It causes a kernel panic if the watchdog times out. It allows
	   for the detection of cpu hangs and deadlocks. It does not run during the
	   bootup process, so it will not catch any early lockups. Enabling this
	   only enables the framework, an individual Qualcomm Technologies, Inc.
	   watchdog module must be loaded along with this for watchdog
	   functionality.

config QCOM_SOC_WATCHDOG
	tristate "Qualcomm Technologies, Inc. Soc Watchdog"
	depends on QCOM_WDT_CORE
	help
	  This enables the Qualcomm Technologies, Inc. watchdog module for the
	  Soc. It provides an interface to perform watchdog actions such as
	  setting the bark/bite time and also petting the hardware watchdog. To
	  utilize this the Qualcomm Technologies, Inc. watchdog framework must
	  also be enabled.

config QCOM_IRQ_STAT
	bool "QCOM IRQ stats"
	default y
	depends on QCOM_WDT_CORE && ANDROID_VENDOR_OEM_DATA
	help
	  This give irq stats for top hitter at
	  watchdog bark and kernel panics.
	  This provides additional debug information
	  for irq counts.

config QCOM_FORCE_WDOG_BITE_ON_PANIC
	bool "QCOM force watchdog bite on panic"
	depends on QCOM_WDT_CORE
	help
	  This forces a watchdog bite when the device restarts
	  due to a kernel panic. On certain MSM SoCs,
	  this provides additional debugging
	  information.

config QCOM_WDOG_BITE_EARLY_PANIC
	bool "QCOM early panic watchdog bite"
	depends on QCOM_WDT_CORE && QCOM_FORCE_WDOG_BITE_ON_PANIC
	help
	  This forces a watchdog bite early in panic sequence. On certain
	  MSM SoCs, this provides us additional debugging information at the
	  context of the crash. If this option is disabled, then bite occurs
	  later in panic, which permits more of the restart sequence to run
	  (e.g. more dmesg to flushed to console).

config QCOM_WATCHDOG_BARK_TIME
	depends on QCOM_WDT_CORE
	int "Qualcomm Technologies, Inc. Watchdog bark time in ms"
	default 11000
	range 11000 11000
	help
	  The amount of time, in milliseconds, that should elapse after
	  a watchdog timer reset before a bark interrupt is sent from the
	  watchdog.

config QCOM_WATCHDOG_PET_TIME
	depends on QCOM_WDT_CORE
	int "Qualcomm Technologies, Inc. Watchdog pet time in ms"
	default 9360
	range 9360 9360
	help
	  The amount of time, in milliseconds, that should elapse before
	  a watchdog pet is initiated to reset the watchdog timer to 0.

config QCOM_WATCHDOG_IPI_PING
	depends on QCOM_WDT_CORE
	bool "Qualcomm Technologies, Inc. Watchdog ipi ping"
	default y
	help
	  This boolean flag gives the watchdog driver the ability to send a
	  keep-alive ping to other cpu's if it is set to 1. Otherwise, when
	  it is set to 0 no keep alive pings will be sent.

config QCOM_WATCHDOG_WAKEUP_ENABLE
	depends on QCOM_WDT_CORE
	bool "Qualcomm Technologies, Inc. Watchdog wakeup enable"
	default y
	help
	  This boolean flag allows the non secure watchdog counter to freeze
	  and unfreeze automatically across the system suspend and resume
	  path.

config QCOM_WATCHDOG_USERSPACE_PET
	depends on QCOM_WDT_CORE
	bool "Qualcomm Technologies, Inc. Watchdog user pet enable"
	default n
	help
	  This boolean flag allows enabling the userspace-watchdog feature.
	  This feature requires userspace to pet the watchdog every in an
	  interval that matches the time set in the pet-time config.
	  The feature is supported through device sysfs files.

config QCOM_WCNSS_CTRL
	tristate "Qualcomm WCNSS control driver"
	depends on ARCH_QCOM || COMPILE_TEST
	depends on RPMSG
	help
	  Client driver for the WCNSS_CTRL SMD channel, used to download nv
	  firmware to a newly booted WCNSS chip.

config QCOM_APR
	tristate "Qualcomm APR/GPR Bus (Asynchronous/Generic Packet Router)"
	depends on ARCH_QCOM || COMPILE_TEST
	depends on RPMSG
	depends on NET
	select QCOM_PDR_HELPERS
	help
	  Enable APR IPC protocol support between
	  application processor and QDSP6. APR is
	  used by audio driver to configure QDSP6
	  ASM, ADM and AFE modules.

config QPNP_PBS
	tristate "PBS trigger support for QPNP PMIC"
	depends on SPMI
	help
	  This driver supports configuring software PBS trigger event through PBS
	  RAM on Qualcomm Technologies, Inc. QPNP PMICs. This module provides
	  the APIs to the client drivers that wants to send the PBS trigger
	  event to the PBS RAM.

config QCOM_RAMDUMP
	tristate "Qualcomm Technologies, Inc. Ramdump driver"
	default n
	help
	  This option enables the QTI ramdump driver. The ramdump driver
	  provides APIs to collect ramdumps which can be extracted from
	  userspace. Say 'Y' here to enable this driver. It's safe to say
	  'N' here if you don't plan on collecting ramdumps.

config QCOM_ICC_BWMON
	tristate "QCOM Interconnect Bandwidth Monitor driver"
	depends on ARCH_QCOM || COMPILE_TEST
	select PM_OPP
	select REGMAP_MMIO
	help
	  Sets up driver monitoring bandwidth on various interconnects and
	  based on that voting for interconnect bandwidth, adjusting their
	  speed to current demand.
	  Current implementation brings support for BWMON v4, used for example
	  on SDM845 to measure bandwidth between CPU (gladiator_noc) and Last
	  Level Cache (memnoc).  Usage of this BWMON allows to remove some of
	  the fixed bandwidth votes from cpufreq (CPU nodes) thus achieve high
	  memory throughput even with lower CPU frequencies.

config QCOM_SECURE_BUFFER
	tristate "Helper functions for secure buffers through TZ"
	depends on QCOM_SCM
	help
	  Enable for targets that need to call into TZ to secure
	  memory buffers. This ensures that only the correct clients can
	  use this memory and no unauthorized access is made to the
	  buffer.

config QCOM_PANEL_EVENT_NOTIFIER
	tristate "panel event notifier"
	depends on DRM
	help
	  Enabling this option adds panel event notifier driver.
	  This driver is responsible for notifying clients interested in display
	  panel events such as panel on , panel off, fps change etc.  clients
	  can use these notifications for power saving or align its operations
	  with display panel power state.

source "drivers/soc/qcom/mem_buf/Kconfig"

config QTI_PMIC_GLINK
	tristate "Enable support for PMIC GLINK"
	depends on RPMSG
	select QCOM_RPROC_COMMON
	select QCOM_PDR_HELPERS
	help
	  The PMIC Glink driver provides the interface for clients to
	  communicate over GLink for sending and receiving data to charger
	  firmware that runs on a remote subsystem like DSP which supports
	  charging and gauging.
	  This enables clients to read and write battery charging parameters.

config QTI_PMIC_GLINK_CLIENT_DEBUG
	depends on QTI_PMIC_GLINK && DEBUG_FS
	bool "Enable debugfs features in PMIC GLINK client drivers"
	help
	  This option enables the generation of debugfs files in PMIC GLINK
	  client drivers that are strictly meant for internal debugging only.
	  Writing to these debug files changes key physical parameters of a
	  system, which may lead to instability. Therefore, this option should
	  never be enabled on production devices.

config QTI_ALTMODE_GLINK
	tristate "Type-C alternate mode over GLINK"
	depends on QTI_PMIC_GLINK
	help
	  The Qualcomm Technologies, Inc. Type-C alternate mode driver provides
	  an interface for Type-C alternate mode clients to receive data such
	  as Pin Assignment Notifications from the Type-C stack running on a
	  remote subsystem (e.g. DSP) via the PMIC GLINK interface.

config QTI_PMIC_PON_LOG
	tristate "PMIC PON log parser driver"
	help
	  The PMIC PON log driver parses PMIC power-on, power-off, and fault
	  information out of a binary log stored in the SDAM memory found on
	  some Qualcomm Technologies, Inc. PMIC devices.  This driver is useful
	  when debugging unexpected power-off scenarios.

endmenu
```
